## board/Kconfig
```kconfig
menu "Hardware Drivers Config"

config SOC_STM32F103VE
    bool
    select SOC_SERIES_STM32F1
    select RT_USING_COMPONENTS_INIT
    select RT_USING_USER_MAIN
    default y

menu "Onboard Peripheral Drivers"

endmenu

menu "On-chip Peripheral Drivers"

    config BSP_USING_GPIO
        bool "Enable GPIO"
        select RT_USING_PIN
        default y
		
	config BSP_USING_ON_CHIP_FLASH
        bool "Enable on-chip FLASH"
        default n
		
    menuconfig BSP_USING_UART
        bool "Enable UART"
        default y
        select RT_USING_SERIAL
        if BSP_USING_UART
            config BSP_USING_UART1
                bool "Enable UART1 -------"
                default n
				
			config BSP_UART1_TX_USING_DMA
                bool "Enable UART1 TX DMA"
                depends on BSP_USING_UART1 && RT_SERIAL_USING_DMA
                default n
				
		    config BSP_UART1_RX_USING_DMA
                bool "Enable UART1 RX DMA"
                depends on BSP_USING_UART1 && RT_SERIAL_USING_DMA
                default n
				
			config BSP_UART1_TX_BUFSIZE
				int "Set UART1 TX buffer size"
				range 0 2048
				default 128	
			
			config BSP_UART1_RX_BUFSIZE
				int "Set UART1 RX buffer size"
				range 0 2048
				default 128

            config BSP_USING_UART2
                bool "Enable UART2 -------"
                default n
				
			config BSP_UART2_TX_USING_DMA
                bool "Enable UART2 TX DMA"
                depends on BSP_USING_UART2 && RT_SERIAL_USING_DMA
                default n
				
		    config BSP_UART2_RX_USING_DMA
                bool "Enable UART2 RX DMA"
                depends on BSP_USING_UART2 && RT_SERIAL_USING_DMA
                default n
				
			config BSP_UART2_TX_BUFSIZE
				int "Set UART2 TX buffer size"
				range 0 2048
				default 128	
			
			config BSP_UART2_RX_BUFSIZE
				int "Set UART2 RX buffer size"
				range 0 2048
				default 128
				
			config BSP_USING_UART3
                bool "Enable UART3 -------"
                default n
			
			config BSP_UART3_TX_USING_DMA
                bool "Enable UART3 TX DMA"
                depends on BSP_USING_UART3 && RT_SERIAL_USING_DMA
                default n
				
			config BSP_UART3_RX_USING_DMA
                bool "Enable UART3 RX DMA"
                depends on BSP_USING_UART3 && RT_SERIAL_USING_DMA
                default n
				
			config BSP_UART3_TX_BUFSIZE
				int "Set UART3 TX buffer size"
				range 0 2048
				default 128
			
			config BSP_UART3_RX_BUFSIZE
				int "Set UART3 RX buffer size"
				range 0 2048
				default 128

            config BSP_USING_UART4
                bool "Enable UART4 -------"
                default n
				
			config BSP_UART4_TX_USING_DMA
                bool "Enable UART4 TX DMA"
                depends on BSP_USING_UART4 && RT_SERIAL_USING_DMA
                default n
				
		    config BSP_UART4_RX_USING_DMA
                bool "Enable UART4 RX DMA"
                depends on BSP_USING_UART4 && RT_SERIAL_USING_DMA
                default n
				
			config BSP_UART4_TX_BUFSIZE
				int "Set UART4 TX buffer size"
				range 0 2048
				default 128	
			
			config BSP_UART4_RX_BUFSIZE
				int "Set UART4 RX buffer size"
				range 0 2048
				default 128
                     
            config BSP_USING_UART5
                bool "Enable UART5 -------"
                default n
				
			config BSP_UART5_TX_BUFSIZE
				int "Set UART5 TX buffer size"
				range 0 2048
				default 128	
			
			config BSP_UART5_RX_BUFSIZE
				int "Set UART5 RX buffer size"
				range 0 2048
				default 128
		
        endif

    source "libraries/HAL_Drivers/Kconfig"
       
endmenu

menu "Board extended module Drivers"

endmenu

endmenu
```
